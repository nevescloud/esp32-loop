## examples/ble_control/sdkconfig.defaults
```kconfig
# BLE via NimBLE. The stack pushes the app past the default 1 MB partition,
# so use the large single-app layout on the 4 MB flash these boards carry.
CONFIG_BT_ENABLED=y
CONFIG_BT_NIMBLE_ENABLED=y
CONFIG_ESPTOOLPY_FLASHSIZE_4MB=y
CONFIG_PARTITION_TABLE_SINGLE_APP_LARGE=y
```

## examples/ble_control/sdkconfig.defaults.esp32
```kconfig
# Classic ESP32: console on UART0 (the bridge), BLE-only controller to save RAM.
CONFIG_ESP_CONSOLE_UART_DEFAULT=y
CONFIG_BTDM_CTRL_MODE_BLE_ONLY=y
```

## examples/wifi_provision/sdkconfig.defaults
```kconfig
# NimBLE + WiFi STA sharing one 2.4 GHz radio — the provisioning lane needs both
# up at once, so software coexistence is on. The combined stack pushes the app
# past the default 1 MB partition; use the large single-app layout on 4 MB flash.
CONFIG_BT_ENABLED=y
CONFIG_BT_NIMBLE_ENABLED=y
CONFIG_ESP_COEX_SW_COEXIST_ENABLE=y
CONFIG_ESPTOOLPY_FLASHSIZE_4MB=y
CONFIG_PARTITION_TABLE_SINGLE_APP_LARGE=y
```

## examples/wifi_provision/sdkconfig.defaults.esp32
```kconfig
# Classic ESP32: console on UART0 (the bridge), BLE-only controller (+WiFi via coexist).
CONFIG_ESP_CONSOLE_UART_DEFAULT=y
CONFIG_BTDM_CTRL_MODE_BLE_ONLY=y
```

## examples/wifi_provision/sdkconfig.defaults.esp32c3
```kconfig
# C3: console on native USB-Serial-JTAG (read it on cu.usbmodem*).
CONFIG_ESP_CONSOLE_USB_SERIAL_JTAG=y
```
